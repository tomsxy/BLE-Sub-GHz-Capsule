## sysbuild.conf
```
#
# Copyright (c) 2024 Nordic Semiconductor
#
# SPDX-License-Identifier: LicenseRef-Nordic-5-Clause
#

SB_CONFIG_NETCORE_HCI_IPC=y
```

## prj.conf
```kconfig
#
# Copyright (c) 2022 Nordic Semiconductor ASA
#
# SPDX-License-Identifier: LicenseRef-Nordic-5-Clause
#

# Wi-Fi
CONFIG_WIFI=y
CONFIG_WIFI_NRF700X=y

# WPA supplicant
CONFIG_WPA_SUPP=y

# Soft AP Mode
CONFIG_NRF700X_AP_MODE=y
CONFIG_WPA_SUPP_AP=y
CONFIG_WPA_SUPP_LOG_LEVEL_INF=y
# CONFIG_WIFI_READY_LIB=y
CONFIG_FILE_SYSTEM=y

# CONFIG_SOFTAP_SAMPLE_5GHz=y
# CONFIG_SOFTAP_SAMPLE_CHANNEL=36


CONFIG_SOFTAP_SAMPLE_5GHz=n
CONFIG_SOFTAP_SAMPLE_CHANNEL=6


CONFIG_SOFTAP_SAMPLE_REG_DOMAIN="NO"
CONFIG_SAMPLE_SCOKET_TCP=n
CONFIG_SOFTAP_SAMPLE_SSID="WiFi_Cam_Demo_AP"
CONFIG_SOFTAP_SAMPLE_PASSWORD="nRF7002DK"


# Station Mode
# Configure the Wi-Fi credentials
CONFIG_WIFI_CREDENTIALS=y
CONFIG_SHELL_BACKEND_SERIAL=y
CONFIG_WIFI_CREDENTIALS_STATIC=n
CONFIG_WIFI_CREDENTIALS_BACKEND_SETTINGS=y
CONFIG_WIFI_CREDENTIALS_STATIC_SSID="YOUR_WIFI_SSID"
CONFIG_WIFI_CREDENTIALS_STATIC_PASSWORD="YOUR_WIFI_PASSWORD"
CONFIG_FLASH=y
CONFIG_FLASH_PAGE_LAYOUT=y
CONFIG_FLASH_MAP=y
CONFIG_NVS=y
CONFIG_SETTINGS=y
CONFIG_SETTINGS_NVS=y
# Enable support for shell commands
CONFIG_SHELL=y
CONFIG_SHELL_STACK_SIZE=4600
CONFIG_WIFI_CREDENTIALS_SHELL=y

# Networking Management API
# Enable the Network Management relevant configurations
CONFIG_NET_MGMT=y
CONFIG_NET_MGMT_EVENT=y
CONFIG_NET_MGMT_EVENT_INFO=y
CONFIG_NET_MGMT_EVENT_STACK_SIZE=4600
CONFIG_NET_CONNECTION_MANAGER=y
#CONFIG_L2_WIFI_CONNECTIVITY=y

# Logging
CONFIG_LOG=y
CONFIG_LOG_DEFAULT_LEVEL=3
CONFIG_USE_SEGGER_RTT=y
CONFIG_LOG_BACKEND_RTT=y
CONFIG_LOG_BACKEND_UART=y
CONFIG_LOG_PRINTK=y

CONFIG_ASSERT=y

# DK library
CONFIG_DK_LIBRARY=y

# Networking
CONFIG_NETWORKING=y
CONFIG_NET_NATIVE=y
CONFIG_NET_SOCKETS=y
CONFIG_NET_LOG=y
CONFIG_NET_IPV4=y
CONFIG_NET_TCP=y
CONFIG_NET_UDP=y
CONFIG_NET_DHCPV4=y
# 高带宽
CONFIG_NRF700X_AP_MODE=n
CONFIG_NRF700X_P2P_MODE=n
CONFIG_SPEED_OPTIMIZATIONS=y
CONFIG_NRF700X_QSPI_LOW_POWER=n
CONFIG_NRF700X_UTIL=n
CONFIG_NRF700X_MAX_TX_AGGREGATION=9
CONFIG_NRF700X_MAX_TX_TOKENS=12
CONFIG_POSIX_MAX_FDS=20
CONFIG_NET_SOCKETS_POLL_MAX=20



CONFIG_NET_PKT_RX_COUNT=6
CONFIG_NET_PKT_TX_COUNT=10

# Below section is the primary contributor to SRAM and is currently
# tuned for performance, but this will be revisited in the future.
CONFIG_NET_BUF_RX_COUNT=6
CONFIG_NET_BUF_TX_COUNT=42
CONFIG_NET_BUF_DATA_SIZE=1100
CONFIG_HEAP_MEM_POOL_SIZE=200000
CONFIG_NET_TC_TX_COUNT=1

CONFIG_NET_IF_UNICAST_IPV4_ADDR_COUNT=1
CONFIG_NET_MAX_CONTEXTS=5
CONFIG_NET_CONTEXT_SYNC_RECV=y

CONFIG_INIT_STACKS=y

CONFIG_NET_L2_ETHERNET=y

CONFIG_NET_CONFIG_SETTINGS=y
CONFIG_NET_CONFIG_INIT_TIMEOUT=0

CONFIG_NET_SOCKETS_POLL_MAX=10

CONFIG_NET_CONFIG_MY_IPV4_ADDR="192.168.1.1"
CONFIG_NET_CONFIG_MY_IPV4_NETMASK="255.255.255.0"
CONFIG_NET_CONFIG_MY_IPV4_GW="192.168.1.1"

# printing of scan results puts pressure on queues in new locking
# design in net_mgmt. So, use a higher timeout for a crowded
# environment.
CONFIG_NET_MGMT_EVENT_QUEUE_TIMEOUT=5000

# Memories
CONFIG_MAIN_STACK_SIZE=4096
CONFIG_SYSTEM_WORKQUEUE_STACK_SIZE=2048
CONFIG_NET_TX_STACK_SIZE=4096
CONFIG_NET_RX_STACK_SIZE=4096

# Bluetooth
CONFIG_BT=y
CONFIG_BT_PERIPHERAL=y
CONFIG_BT_GATT_CLIENT=y
CONFIG_BT_DEVICE_NAME="WiFi_BLE_Cam_DemoZZY"
CONFIG_BT_DEVICE_APPEARANCE=833
CONFIG_BT_MAX_CONN=1
CONFIG_BT_MAX_PAIRED=1
CONFIG_BT_BUF_ACL_RX_SIZE=502
CONFIG_BT_ATT_PREPARE_COUNT=2
CONFIG_BT_L2CAP_TX_BUF_COUNT=10
CONFIG_BT_L2CAP_TX_MTU=498
CONFIG_BT_CONN_TX_MAX=10
CONFIG_BT_BUF_ACL_TX_COUNT=10
CONFIG_BT_BUF_ACL_TX_SIZE=502
CONFIG_BT_USER_DATA_LEN_UPDATE=y
CONFIG_BT_USER_PHY_UPDATE=y
CONFIG_BT_HCI_CORE_LOG_LEVEL_INF=y
CONFIG_BT_RX_STACK_SIZE=8192

# Kernel options
CONFIG_ENTROPY_GENERATOR=y

# # Arducam Mega SPI Camera
# CONFIG_SPI=y
# CONFIG_VIDEO=y
# CONFIG_VIDEO_INIT_PRIORITY=72
# CONFIG_VIDEO_BUFFER_POOL_SZ_MAX=8192
# CONFIG_VIDEO_BUFFER_POOL_NUM_MAX=3

CONFIG_DEBUG=y




# #需要跑满BLE带宽
# CONFIG_BT_CTLR_PHY_2M=y
# CONFIG_BT_USER_PHY_UPDATE=y
# #需要功率控制
# CONFIG_BT_CTLR_TX_PWR_DYNAMIC_CONTROL=y
# CONFIG_BT_CTLR_ADVANCED_FEATURES=y

# SB_CONFIG_NETCORE_HCI_IPC=y
#FEM general
# CONFIG_MPSL_FEM=y
# CONFIG_MPSL=y
# CONFIG_MPSL_FEM_NRF21540_GPIO=y
# CONFIG_BT_CTLR_TX_PWR_DYNAMIC_CONTROL=y
# CONFIG_MPSL_FEM_NRF21540_TX_GAIN_DB=20
# CONFIG_MPSL_FEM_NRF21540_RX_GAIN_DB=13
# CONFIG_MPSL_FEM_NRF21540_RUNTIME_PA_GAIN_CONTROL=y
CONFIG_BT_CTLR_TX_PWR_ANTENNA=3


#打印浮点数
CONFIG_CBPRINTF_FP_SUPPORT=y

# CONFIG_CLOCK_CONTROL_NRF_K32SRC_RC=y
# CONFIG_CLOCK_CONTROL_NRF_K32SRC_RC_CALIBRATION=y
# CONFIG_CLOCK_CONTROL_NRF_K32SRC_500PPM=y

#打开TCP socket
CONFIG_SAMPLE_SCOKET_TCP=y
```

## boards/nrf7002dk_nrf5340_cpuapp.overlay
```dts
// &pinctrl {
//     spi1_default: spi1_default {
//         group1 {
//             psels = <NRF_PSEL(SPIM_SCK, 1, 15)>,
//                     <NRF_PSEL(SPIM_MOSI, 1, 13)>,
//                     <NRF_PSEL(SPIM_MISO, 1, 14)>;
//         };
//     };

//     spi1_sleep: spi1_sleep {
//         group1 {
//             psels = <NRF_PSEL(SPIM_SCK, 1, 15)>,
//                     <NRF_PSEL(SPIM_MOSI, 1, 13)>,
//                     <NRF_PSEL(SPIM_MISO, 1, 14)>;
//             low-power-enable;
//         };
//     };
// };

// &uart0 {
//     current-speed = <115200>;
// };

// &spi1 {
//     status = "okay";
//     clock-frequency = <8000000>;
//     compatible = "nordic,nrf-spim";
//     pinctrl-0 = <&spi1_default>;
//     pinctrl-1 = <&spi1_sleep>;
//     pinctrl-names = "default", "sleep";
//     cs-gpios = <&gpio1 12 GPIO_ACTIVE_LOW>;

//     /* 把原来的 arducam-mega0 节点改为一个 Zephyr spidev 设备 */
//     spidev@0 {
//         compatible = "zephyr,spidev";
//         reg = <0>;                       /* SPI 片选号 */
//         spi-max-frequency = <8000000>;
//         status = "okay";
//     };
// };

// &gpio_fwd {
//     nrf21540-gpio-if {
//         gpios = <&gpio0 5 0>,  /* tx-en-gpios */
//                 <&gpio0 6 0>,  /* rx-en-gpios */
//                 <&gpio0 7 0>,  /* pdn-gpios   */
//                 <&gpio0 25 0>;  /* mode-gpios  */
//     };
// };
```

## boards/nrf7002dk_nrf5340_cpuapp_ns.overlay
```dts
&uart0{
	current-speed = <115200>;
};

// &pinctrl {
// 	spi1_default: spi1_default {
// 			group1 {
// 					psels = <NRF_PSEL(SPIM_SCK, 1, 15)>,
// 							<NRF_PSEL(SPIM_MOSI, 1, 13)>,
// 							<NRF_PSEL(SPIM_MISO, 1, 14)>;
// 			};
// 	};

// 	spi1_sleep: spi1_sleep {
// 			group1 {
// 					psels = <NRF_PSEL(SPIM_SCK, 1, 15)>,
// 							<NRF_PSEL(SPIM_MOSI, 1, 13)>,
// 							<NRF_PSEL(SPIM_MISO, 1, 14)>;
// 					low-power-enable;
// 			};
// 	};
// };

// &spi1 {
// 	clock-frequency = <8000000>;
// 	compatible = "nordic,nrf-spim";
// 	status = "okay";
// 	pinctrl-0 = <&spi1_default>;
// 	pinctrl-1 = <&spi1_sleep>;
// 	pinctrl-names = "default", "sleep";
// 	cs-gpios = <&gpio1 12 GPIO_ACTIVE_LOW>;
// 	arducam_mega0:arducam-mega0@0 {
// 			compatible = "arducam,mega";
// 			reg = <0>;
// 			spi-max-frequency = <8000000>;
// 			status = "okay";
// 	};
// };

// &gpio_fwd {
//     nrf21540-gpio-if {
//         gpios = <&gpio0 5 0>,  /* tx-en-gpios */
//                 <&gpio0 6 0>,  /* rx-en-gpios */
//                 <&gpio0 7 0>,  /* pdn-gpios   */
//                 <&gpio0 25 0>;  /* mode-gpios  */
//     };
// };
```

## include/app_bluetooth.h
```c
#ifndef __APP_BLUETOOTH_H
#define __APP_BLUETOOTH_H

#include <zephyr/types.h>
#include <zephyr/kernel.h>

// Callbacks from the app_bluetooth module to the application
typedef void (*app_bt_connected_cb)(void);
typedef void (*app_bt_ready_cb)(void);
typedef void (*app_bt_disconnected_cb)(void);
typedef void (*app_bt_take_picture_cb)(void);
typedef void (*app_bt_enable_stream_cb)(bool enable);
typedef void (*app_bt_change_resolution_cb)(uint8_t resolution);

struct app_bt_cb {
    app_bt_connected_cb connected;
    app_bt_ready_cb ready;
    app_bt_disconnected_cb disconnected;
    app_bt_take_picture_cb take_picture;
    app_bt_enable_stream_cb enable_stream;
    app_bt_change_resolution_cb change_resolution;
};

int app_bt_init(const struct app_bt_cb *callbacks);

int app_bt_send_picture_header(uint32_t pic_size);

int app_bt_send_picture_data(const uint8_t *buf, uint16_t len);

int app_bt_send_client_status(uint8_t cam_model, uint8_t resolution);

#endif
```

## include/its.h
```c
/*
 * Copyright (c) 2018 Nordic Semiconductor ASA
 *
 * SPDX-License-Identifier: LicenseRef-Nordic-5-Clause
 */

#ifndef __BT_ITS_H
#define __BT_ITS_H

#ifdef __cplusplus
extern "C" {
#endif

#include <zephyr/types.h>

#define BT_UUID_ITS_VAL \
	BT_UUID_128_ENCODE(0x6E400001, 0xB5A3, 0xF393, 0xE0A9, 0xE50E24DCCA3E)

#define BT_UUID_ITS_TX_VAL \
	BT_UUID_128_ENCODE(0x6E400003, 0xB5A3, 0xF393, 0xE0A9, 0xE50E24DCCA3E)

#define BT_UUID_ITS_RX_VAL \
	BT_UUID_128_ENCODE(0x6E400002, 0xB5A3, 0xF393, 0xE0A9, 0xE50E24DCCA3E)

#define BT_UUID_ITS_IMG_INFO_VAL \
	BT_UUID_128_ENCODE(0x6E400004, 0xB5A3, 0xF393, 0xE0A9, 0xE50E24DCCA3E)

#define BT_UUID_ITS           BT_UUID_DECLARE_128(BT_UUID_ITS_VAL)
#define BT_UUID_ITS_TX    	  BT_UUID_DECLARE_128(BT_UUID_ITS_TX_VAL)
#define BT_UUID_ITS_RX        BT_UUID_DECLARE_128(BT_UUID_ITS_RX_VAL)
#define BT_UUID_ITS_IMG_INFO  BT_UUID_DECLARE_128(BT_UUID_ITS_IMG_INFO_VAL)

enum its_rx_cmd_e {
	ITS_RX_CMD_SINGLE_CAPTURE = 1,
	ITS_RX_CMD_START_STREAM,
	ITS_RX_CMD_STOP_STREAM,
	ITS_RX_CMD_CHANGE_RESOLUTION,
	ITS_RX_CMD_CHANGE_PHY,
	ITS_RX_CMD_SEND_BLE_PARAMS,
	ITS_RX_CMD_TXP, 
	ITS_RX_CMD_WIFIONOFF,
	ITS_RX_CMD_WIFIACTIVE,
	ITS_RX_CMD_THROUGHPUT_NOTIFY,
	ITS_RX_CMD_BORDER_NOTIFY

};

struct its_rx_cb_evt_t {
	enum its_rx_cmd_e command;
	uint8_t *data;
	uint32_t len;
};

/** @brief Callback type for when the ITS service is ready */
typedef void (*its_ready_cb_t)(void);

/** @brief Callback type for when RX data is received. */
typedef void (*its_rx_cb_t)(struct its_rx_cb_evt_t *evt);

/** @brief Callback struct used by the ITS Service. */
struct bt_its_cb {
	/** ITS Ready callback */
	its_ready_cb_t ready_cb;
	
	/** ITS RX callback. */
	its_rx_cb_t rx_cb;
};

enum its_img_info_data_type_e {ITS_IMG_INFO_DATA_TYPE_IMG_INFO = 1, ITS_IMG_INFO_DATA_TYPE_BLE_PARAMS = 2, ITS_IMG_INFO_DATA_TYPE_CLIENT_STATUS = 3};

struct its_img_info_t {
    uint32_t file_size_bytes;   
};

struct its_ble_params_info_t {
    uint16_t mtu;
    uint16_t con_interval;
    uint8_t  tx_phy;
    uint8_t  rx_phy;
};

enum its_camera_type_e {ITS_CAM_TYPE_3MP = 1, ITS_CAM_TYPE_5MP = 2};

struct its_client_status_t {
	uint8_t camera_type;
	uint8_t selected_resolution_index;
};

int bt_its_init(struct bt_its_cb *callbacks);

int bt_its_send_img_data(struct bt_conn *conn, const uint8_t *buf, uint16_t length, uint16_t le_max_length);

int bt_its_send_img_info(struct its_img_info_t *img_info);

int bt_its_send_ble_params_info(struct its_ble_params_info_t *ble_params_info);

int bt_its_send_client_status(struct its_client_status_t *client_status);

#ifdef __cplusplus
}
#endif

#endif /* BT_ITS_H_ */
```

## include/wifi_cli.h
```c
#pragma once
#ifdef __cplusplus
extern "C" {
#endif

int wifi_cli_init(void);
int wifi_cli_do_up(void);
int wifi_cli_do_shutdown(void);

#ifdef __cplusplus
}
#endif
```

## src/app_bluetooth.c
```c
#include "app_bluetooth.h"

#include <zephyr/bluetooth/bluetooth.h>
#include <zephyr/bluetooth/uuid.h>
#include <zephyr/bluetooth/gatt.h>
#include <zephyr/bluetooth/hci.h>
#include <zephyr/settings/settings.h>
#include "its.h"
#include <zephyr/bluetooth/conn.h>
 #include <zephyr/bluetooth/hci_vs.h>
#include <zephyr/logging/log.h>
#include <zephyr/sys/byteorder.h>     // sys_cpu_to_le16()
#include <zephyr/bluetooth/conn.h>    // bt_conn_get_handle()
#include "wifi_cli.h"
#define LOG_MODULE_NAME app_bluetooth
LOG_MODULE_REGISTER(LOG_MODULE_NAME, LOG_LEVEL_INF);

#define DEVICE_NAME CONFIG_BT_DEVICE_NAME
#define DEVICE_NAME_LEN	(sizeof(DEVICE_NAME) - 1)

static const struct bt_le_conn_param *conn_param = BT_LE_CONN_PARAM(6, 6, 0, 400);


struct client_state {
    uint8_t req_stream      : 1;
    uint8_t req_stream_stop : 1;
    uint8_t stream_active   : 1;
};


extern struct client_state client_state_socket;

static struct bt_conn *current_conn;
 static uint16_t default_conn_handle;

static app_bt_connected_cb app_callback_connected;
static app_bt_ready_cb app_callback_ready;
static app_bt_disconnected_cb app_callback_disconnected;
static app_bt_take_picture_cb app_callback_take_picture;
static app_bt_enable_stream_cb app_callback_enable_stream;
static app_bt_change_resolution_cb app_callback_change_resolution;
static struct its_ble_params_info_t ble_params_info = {.con_interval = 0, .mtu = 23, .tx_phy = 1, .rx_phy = 1};

// In order to maximize data throughput, scale the notifications after the TX data length
static int le_tx_data_length = 20;

#include <string.h>  // memcpy()

static float read_le_f32(const uint8_t *p)
{
    uint32_t u = sys_get_le32(p);  // <zephyr/sys/byteorder.h> 已经包含
    float f;
    memcpy(&f, &u, sizeof(f));     // 避免严格别名引发的问题
    return f;
}


 static void set_tx_power(uint8_t handle_type, uint16_t handle, int8_t tx_pwr_lvl)
 {
	 struct bt_hci_cp_vs_write_tx_power_level *cp;
	 struct bt_hci_rp_vs_write_tx_power_level *rp;
	 struct net_buf *buf, *rsp = NULL;
	 int err;
 
	 buf = bt_hci_cmd_create(BT_HCI_OP_VS_WRITE_TX_POWER_LEVEL,
				 sizeof(*cp));
	 if (!buf) {
		 printk("Unable to allocate command buffer\n");
		 return;
	 }
 
	 cp = net_buf_add(buf, sizeof(*cp));
	 cp->handle = sys_cpu_to_le16(handle);
	 cp->handle_type = handle_type;
	 cp->tx_power_level = tx_pwr_lvl;
 
	 err = bt_hci_cmd_send_sync(BT_HCI_OP_VS_WRITE_TX_POWER_LEVEL,
					buf, &rsp);
	 if (err) {
		 printk("Set Tx power err: %d\n", err);
		 return;
	 }
 
	 rp = (void *)rsp->data;
	 //printk("Actual Tx Power: %d\n", rp->selected_tx_power);
 
	 net_buf_unref(rsp);
 }
 
 static void get_tx_power(uint8_t handle_type, uint16_t handle, int8_t *tx_pwr_lvl)
 {
	 struct bt_hci_cp_vs_read_tx_power_level *cp;
	 struct bt_hci_rp_vs_read_tx_power_level *rp;
	 struct net_buf *buf, *rsp = NULL;
	 int err;
 
	 *tx_pwr_lvl = 0xFF;
	 buf = bt_hci_cmd_create(BT_HCI_OP_VS_READ_TX_POWER_LEVEL,
				 sizeof(*cp));
	 if (!buf) {
		 printk("Unable to allocate command buffer\n");
		 return;
	 }
 
	 cp = net_buf_add(buf, sizeof(*cp));
	 cp->handle = sys_cpu_to_le16(handle);
	 cp->handle_type = handle_type;
 
	 err = bt_hci_cmd_send_sync(BT_HCI_OP_VS_READ_TX_POWER_LEVEL,
					buf, &rsp);
	 if (err) {
		 printk("Read Tx power err: %d\n", err);
		 return;
	 }
 
	 rp = (void *)rsp->data;
	 *tx_pwr_lvl = rp->tx_power_level;
 
	 net_buf_unref(rsp);
 }

enum app_bt_internal_commands {APP_BT_INT_ITS_RX_EVT, APP_BT_INT_SCHEDULE_CONNECTED_CB, APP_BT_INT_SCHEDULE_READY_CB, APP_BT_INT_SCHEDULE_DISCONNECTED_CB, APP_BT_INT_SCHEDULE_BLE_PARAMS_INFO_UPDATE};
static struct its_rx_cb_evt_t internal_command_evt;

void schedule_ble_params_info_update(void);

struct app_bt_command {
	enum app_bt_internal_commands command;
	struct its_rx_cb_evt_t its_rx_event;
};
K_MSGQ_DEFINE(msgq_its_rx_commands, sizeof(struct app_bt_command), 8, 4);

static const struct bt_data ad[] = {
	BT_DATA_BYTES(BT_DATA_FLAGS, (BT_LE_AD_GENERAL | BT_LE_AD_NO_BREDR)),
	BT_DATA(BT_DATA_NAME_COMPLETE, DEVICE_NAME, DEVICE_NAME_LEN),
};

static const struct bt_data sd[] = {
	BT_DATA_BYTES(BT_DATA_UUID128_ALL, BT_UUID_ITS_VAL),
};

static int schedule_internal_command(enum app_bt_internal_commands command)
{
	internal_command_evt.command = command;
	if (k_msgq_put(&msgq_its_rx_commands, &internal_command_evt, K_NO_WAIT) != 0){
		LOG_ERR("RX cmd message queue full!");
		return -ENOMEM;
	}
	return 0;
}

void att_mtu_updated(struct bt_conn *conn, uint16_t tx, uint16_t rx)
{
	LOG_INF("MTU Updated: tx %d, rx %d", tx, rx);
}

static struct bt_gatt_cb gatt_cb = {
	.att_mtu_updated = att_mtu_updated,
};

static void mtu_exchange_cb(struct bt_conn *conn, uint8_t err, struct bt_gatt_exchange_params *params)
{
	if (!err) {
		int att_mtu = bt_gatt_get_mtu(conn);
		LOG_INF("MTU exchange successful. %i bytes", att_mtu - 3); 
	} else {
		LOG_WRN("MTU exchange failed (err %" PRIu8 ")", err);
	}
}

static void connected(struct bt_conn *conn, uint8_t err)
{
	char addr[BT_ADDR_LE_STR_LEN];

	if (err) {
		LOG_ERR("Connection failed (err %u)", err);
		return;
	}

	bt_addr_le_to_str(bt_conn_get_dst(conn), addr, sizeof(addr));
	LOG_INF("Connected %s", addr);

	current_conn = bt_conn_ref(conn);
 	int ret = bt_hci_get_conn_handle(current_conn,
						  &default_conn_handle);
	static struct bt_gatt_exchange_params exchange_params;
	exchange_params.func = mtu_exchange_cb;

	err = bt_gatt_exchange_mtu(conn, &exchange_params);
	if (err) {
		printk("MTU exchange failed (err %d)\n", err);
	} else {
		printk("MTU exchange pending\n");
	}

	err = bt_conn_le_data_len_update(conn, BT_LE_DATA_LEN_PARAM_MAX);
	if (err) {
		LOG_ERR("LE data length update request failed: %d",  err);
	}

	err = bt_conn_le_param_update(conn, conn_param);
	if (err) {
		LOG_ERR("Cannot update connection parameter (err: %d)", err);
	}

	err = bt_conn_le_phy_update(conn, BT_CONN_LE_PHY_PARAM_2M);
    if (err) {
        LOG_ERR("PHY(2M) request failed: %d", err);
    }
	set_tx_power(BT_HCI_VS_LL_HANDLE_TYPE_CONN,
                                       default_conn_handle, 20);
              

                int8_t txp_get = 0;
                get_tx_power(BT_HCI_VS_LL_HANDLE_TYPE_CONN,
                                   default_conn_handle, &txp_get);
                
                LOG_INF("Inital TXP = %d\n", txp_get);
	schedule_internal_command(APP_BT_INT_SCHEDULE_CONNECTED_CB);
}

static void disconnected(struct bt_conn *conn, uint8_t reason)
{
	char addr[BT_ADDR_LE_STR_LEN];

	bt_addr_le_to_str(bt_conn_get_dst(conn), addr, sizeof(addr));

	LOG_INF("Disconnected: %s (reason %u)", addr, reason);

	if (current_conn) {
		bt_conn_unref(current_conn);
		current_conn = NULL;
	}

	schedule_internal_command(APP_BT_INT_SCHEDULE_DISCONNECTED_CB);
}

static void connection_param_update(struct bt_conn *conn, uint16_t interval, uint16_t latency, uint16_t timeout)
{
	LOG_INF("Con params updated. Connection interval %d ms, latency %i, timeout %i ms", (int) ((float)interval*1.25f), latency, timeout * 10);
	ble_params_info.con_interval = interval;
	schedule_ble_params_info_update();
}

static void le_data_length_updated(struct bt_conn *conn,
				   struct bt_conn_le_data_len_info *info)
{
	LOG_INF("LE data length updated: TX (len: %d time: %d) RX (len: %d time: %d)", 
			info->tx_max_len, info->tx_max_time, info->rx_max_len, info->rx_max_time);

	ble_params_info.mtu = info->tx_max_len;
	schedule_ble_params_info_update();

	// Set the TX data length, which will determine the size of image data transfers. 
	// Subtract 3 bytes for ATT header and 4 bytes for L2CAP header. 
	le_tx_data_length = info->tx_max_len - 7;
	LOG_INF("Notification data length set to %i bytes", le_tx_data_length);
}

static void le_phy_updated(struct bt_conn *conn,
			   struct bt_conn_le_phy_info *param)
{
	LOG_INF("LE PHY updated: TX PHY %i, RX PHY %i\n", param->tx_phy, param->rx_phy);
	ble_params_info.tx_phy = param->tx_phy;
	ble_params_info.rx_phy = param->rx_phy;
	schedule_ble_params_info_update();
}

BT_CONN_CB_DEFINE(conn_callbacks) = {
	.connected    = connected,
	.disconnected = disconnected,
	.le_param_updated = connection_param_update,
	.le_data_len_updated = le_data_length_updated,
	.le_phy_updated = le_phy_updated,
};

void schedule_ble_params_info_update(void)
{
	internal_command_evt.command = APP_BT_INT_SCHEDULE_BLE_PARAMS_INFO_UPDATE;
	if (k_msgq_put(&msgq_its_rx_commands, &internal_command_evt, K_NO_WAIT) != 0){
		LOG_ERR("RX cmd message queue full!");
	}
}

void its_ready_callback(void)
{
	static struct app_bt_command bt_cmd = {.command = APP_BT_INT_SCHEDULE_READY_CB};
	if (k_msgq_put(&msgq_its_rx_commands, &bt_cmd, K_NO_WAIT) != 0) {
		LOG_ERR("APP BT RX CMD queue full");
	}
}

// void its_rx_callback(struct its_rx_cb_evt_t *evt)
// {
// 	static struct app_bt_command bt_cmd = {.command = APP_BT_INT_ITS_RX_EVT};
// 	bt_cmd.its_rx_event = *evt;
// 	if (k_msgq_put(&msgq_its_rx_commands, &bt_cmd, K_NO_WAIT) != 0) {
// 		LOG_ERR("APP BT RX CMD queue full");
// 	}
// }
void its_rx_callback(struct its_rx_cb_evt_t *evt)
{
    /* 先把命令字打出来 */
    printk("ITS RX: cmd=0x%02X, len=%u, data:", (unsigned)evt->command, (unsigned)evt->len);
    for (size_t i = 0; i < evt->len; i++) {
        printk(" %02X", evt->data[i]);
    }
    printk("\n");

    /* 原有入队逻辑 */
    static struct app_bt_command bt_cmd = {.command = APP_BT_INT_ITS_RX_EVT};
    bt_cmd.its_rx_event = *evt;
    if (k_msgq_put(&msgq_its_rx_commands, &bt_cmd, K_NO_WAIT) != 0) {
        LOG_ERR("APP BT RX CMD queue full");
    }
}







static struct bt_its_cb its_cb = {
	.ready_cb = its_ready_callback,
	.rx_cb = its_rx_callback,
};

static void app_bt_thread_func(void)
{
	int err;
	struct app_bt_command app_cmd;
	while (1) {
		k_msgq_get(&msgq_its_rx_commands, &app_cmd, K_FOREVER);

		if(app_cmd.command == APP_BT_INT_ITS_RX_EVT) {
			// Commands originating from the Image Transfer Service
			switch (app_cmd.its_rx_event.command) {
				case ITS_RX_CMD_SINGLE_CAPTURE:
					LOG_DBG("ITS RX CMD: SingleCapture");
					if (app_callback_take_picture) {
						app_callback_take_picture();
					}
					break;
				case ITS_RX_CMD_START_STREAM:
				LOG_DBG("ITS RX CMD: Start Stream");

				/* 只表达 BLE 的意图，不直接干预 Wi-Fi */
				if (app_callback_enable_stream) {
					app_callback_enable_stream(true);
				}
				break;

				case ITS_RX_CMD_STOP_STREAM:
					LOG_DBG("ITS RX CMD: Stop stream");

					/* 只表达“BLE 想停”，不直接停 */
					if (app_callback_enable_stream) {
						app_callback_enable_stream(false);
					}

					/* TX power 是否调整，取决于你的策略 */
					set_tx_power(BT_HCI_VS_LL_HANDLE_TYPE_CONN,
								default_conn_handle, 20);

					int8_t txp_get = 0;
					get_tx_power(BT_HCI_VS_LL_HANDLE_TYPE_CONN,
								default_conn_handle, &txp_get);

					LOG_INF("Fixed TXP = %d\n", txp_get);
					break;

				case ITS_RX_CMD_CHANGE_RESOLUTION:
					LOG_DBG("ITS RX CMD: Change res");
					if (app_callback_change_resolution) {
						app_callback_change_resolution(app_cmd.its_rx_event.data[0]);
					}
					break;
				case ITS_RX_CMD_CHANGE_PHY:
					LOG_DBG("ITS RX CMD: Change phy (%i)", app_cmd.its_rx_event.data[0]);
					err = bt_conn_le_phy_update(current_conn, (app_cmd.its_rx_event.data[0] == 1) ? BT_CONN_LE_PHY_PARAM_2M : BT_CONN_LE_PHY_PARAM_1M);
					if (err) {
						LOG_ERR("Phy update request failed: %d",  err);
					}
					break;
				case ITS_RX_CMD_SEND_BLE_PARAMS:
					LOG_DBG("ITS RX CMD: Send ble params");
					break;

				case ITS_RX_CMD_TXP: {
                /* 期望 payload: int8 dBm（两补码） */
                if (app_cmd.its_rx_event.len < 1) {
                    LOG_WRN("ITS_RX_CMD_TXP: missing param");
                    break;
                }
                // if (!current_conn || default_conn_handle == 0xFFFF) {
                //     LOG_WRN("ITS_RX_CMD_TXP: no active connection handle");
                //     break;
                // }

                int8_t req_dbm = (int8_t)app_cmd.its_rx_event.data[0];


                /* 你指定的 printk 文案 */
                printk("Adaptive Tx power selected = %d\n", req_dbm);

                set_tx_power(BT_HCI_VS_LL_HANDLE_TYPE_CONN,
                                       default_conn_handle, req_dbm);
              

                int8_t txp_get = 0;
                get_tx_power(BT_HCI_VS_LL_HANDLE_TYPE_CONN,
                                   default_conn_handle, &txp_get);
                
                printk("Real TXP = %d\n", txp_get);
            
                break;
            }

            case ITS_RX_CMD_WIFIONOFF: {
					if (app_cmd.its_rx_event.len < 1) {
						LOG_WRN("ITS_RX_CMD_WIFIONOFF: missing param");
						break;
					}
					uint8_t v = app_cmd.its_rx_event.data[0];

					if (v == 0x01) {
						LOG_INF("Wi-Fi: power on via wifi_cli_do_up()");
						int r = wifi_cli_do_up();
						if (r) { LOG_ERR("wifi_cli_do_up() failed: %d", r); }
					} else if (v == 0x00) {
						LOG_INF("Wi-Fi: shutdown requested");
						client_state_socket.req_stream_stop = 1;//inactive wifi
						LOG_INF("Wi-Fi: shutdown via wifi_cli_do_shutdown()");
						
						int r = wifi_cli_do_shutdown();          // ★再关机
						if (r) { LOG_ERR("wifi_cli_do_shutdown() failed: %d", r); }
					} else {
						LOG_WRN("Wi-Fi: unknown param 0x%02X", v);
					}
					break;
				}

		case ITS_RX_CMD_WIFIACTIVE: {
			uint8_t x = app_cmd.its_rx_event.data[0];

			if (x == 0x01) {
				/* 表达：Wi-Fi 想开始 */
				client_state_socket.req_stream = 1;
				printk("WIFI ACTIVE (intent)\n");
			} else if (x == 0x00) {
				/* 表达：Wi-Fi 想停止 */
				client_state_socket.req_stream_stop = 1;
				printk("WIFI INACTIVE (intent)\n");
			}
			break;
		}


	
		case ITS_RX_CMD_THROUGHPUT_NOTIFY: {
			if (app_cmd.its_rx_event.len < 4) {
				LOG_WRN("ITS_RX_CMD_THROUGHPUT_NOTIFY: payload too short (%u)", app_cmd.its_rx_event.len);
				break;
			}
			float tp = read_le_f32(&app_cmd.its_rx_event.data[0]);
			/* 按两位小数输出，例如 1200.00 */
			// printk("THROUGHPUT = %.2f\n", tp);
			LOG_INF("Throughput notify: %.2f", (double)tp);
			break;
		}

		case ITS_RX_CMD_BORDER_NOTIFY: {
			if (app_cmd.its_rx_event.len < 8) {
				LOG_WRN("ITS_RX_CMD_BORDER_NOTIFY: payload too short (%u)", app_cmd.its_rx_event.len);
				break;
			}
			float x = read_le_f32(&app_cmd.its_rx_event.data[0]);
			float y = read_le_f32(&app_cmd.its_rx_event.data[4]);
			/* 按两位小数输出，例如 (300.00, 400.00) */
			// printk("BORDER = (%.2f, %.2f)\n", x, y);
			LOG_INF("Border notify: (%.2f, %.2f)", (double)x, (double)y);
			break;
		}

			
				default:
					LOG_ERR("CMD:Invalid command!");
					break;
			}
		} else {
			switch (app_cmd.command) {
				case APP_BT_INT_SCHEDULE_CONNECTED_CB:
					if (app_callback_connected) {
						app_callback_connected();
					}
					break;
				case APP_BT_INT_SCHEDULE_READY_CB:
					if (app_callback_ready) {
						app_callback_ready();
					}
					break;
				case APP_BT_INT_SCHEDULE_DISCONNECTED_CB:
					if (app_callback_disconnected) {
						app_callback_disconnected();
					}
					break;
				case APP_BT_INT_SCHEDULE_BLE_PARAMS_INFO_UPDATE:
					err = bt_its_send_ble_params_info(&ble_params_info);	
					if (err) {
						LOG_ERR("Error sending ble params");
					}
					break;
				default:
					break;
			}
		}
	}
}

int app_bt_init(const struct app_bt_cb *callbacks)
{
	int err = 0;

	if (callbacks) {
		app_callback_connected = callbacks->connected;
		app_callback_ready = callbacks->ready;
		app_callback_disconnected = callbacks->disconnected;
		app_callback_take_picture = callbacks->take_picture;
		app_callback_enable_stream = callbacks->enable_stream;
		app_callback_change_resolution = callbacks->change_resolution;
	}

	err = bt_enable(NULL);
	if (err) {
		return err;
	}

	LOG_DBG("Bluetooth initialized");

	bt_gatt_cb_register(&gatt_cb);

	if (IS_ENABLED(CONFIG_SETTINGS)) {
		settings_load();
	}

    err = bt_its_init(&its_cb);
	if (err) {
		LOG_ERR("Failed to initialize Image Transfer Service (err: %d)", err);
		return 0;
	}
				/* 扫描功率：handle 固定用 0 */
		set_tx_power(BT_HCI_VS_LL_HANDLE_TYPE_SCAN, 0, 20);

		int8_t scan_txp = 0;
		get_tx_power(BT_HCI_VS_LL_HANDLE_TYPE_SCAN, 0, &scan_txp);
		LOG_INF("SCAN TXP = %d dBm", scan_txp);
			// 广播句柄（legacy/默认广告集为 0）
		static const uint16_t adv_handle = 0;

		set_tx_power(BT_HCI_VS_LL_HANDLE_TYPE_ADV, adv_handle, 20);

		int8_t adv_txp;
		get_tx_power(BT_HCI_VS_LL_HANDLE_TYPE_ADV, adv_handle, &adv_txp);
		LOG_INF("ADV TXP = %d dBm\n", adv_txp);


	err = bt_le_adv_start(BT_LE_ADV_CONN, ad, ARRAY_SIZE(ad), sd, ARRAY_SIZE(sd));
	if (err) {
		LOG_ERR("Advertising failed to start (err %d)", err);
		return err;
	}
	err = wifi_cli_init();
    if (err) {
        LOG_ERR("wifi_cli_init() failed: %d", err);
        return err;
    }
    LOG_INF("wifi_cli_init OK");

    return 0;
}

int app_bt_send_picture_header(uint32_t pic_size)
{
	struct its_img_info_t img_info = {.file_size_bytes = pic_size};
	return bt_its_send_img_info(&img_info);
}

int app_bt_send_picture_data(const uint8_t *buf, uint16_t len)
{
	return bt_its_send_img_data(current_conn, buf, len, le_tx_data_length);
}

int app_bt_send_client_status(uint8_t cam_model, uint8_t resolution)
{
	struct its_client_status_t client_status = {.camera_type = cam_model, .selected_resolution_index = resolution};
	return bt_its_send_client_status(&client_status);
}

K_THREAD_DEFINE(app_bt_thread, 2048, app_bt_thread_func, NULL, NULL, NULL, 
				K_PRIO_PREEMPT(K_LOWEST_APPLICATION_THREAD_PRIO), 0, 0);
```

## src/its.c
```c
/*
 * Copyright (c) 2018 Nordic Semiconductor ASA
 *
 * SPDX-License-Identifier: LicenseRef-Nordic-5-Clause
 */

/** @file
 *  @brief LED Button Service (ITS) sample
 */

#include <zephyr/types.h>
#include <stddef.h>
#include <string.h>
#include <errno.h>
#include <zephyr/sys/printk.h>
#include <zephyr/sys/byteorder.h>
#include <zephyr/kernel.h>

#include <zephyr/bluetooth/bluetooth.h>
#include <zephyr/bluetooth/hci.h>
#include <zephyr/bluetooth/conn.h>
#include <zephyr/bluetooth/uuid.h>
#include <zephyr/bluetooth/gatt.h>

#include "its.h"

#include <zephyr/logging/log.h>

LOG_MODULE_REGISTER(bt_its, LOG_LEVEL_INF);

static bool                   notify_enabled[2];
static struct bt_its_cb       its_cb;
static struct its_rx_cb_evt_t cb_evt;
static struct its_ble_params_info_t scheduled_params = {.con_interval = 0};

static void its_tx_ccc_changed(const struct bt_gatt_attr *attr,
				  uint16_t value)
{
	LOG_DBG("Notify updated on TX char, handle %i, value %i", attr->handle, value);
	notify_enabled[0] = (value == BT_GATT_CCC_NOTIFY);
}

static void its_img_info_ccc_changed(const struct bt_gatt_attr *attr,
				  uint16_t value)
{
	LOG_DBG("Notify updated on img info char, handle %i, value %i", attr->handle, value);
	notify_enabled[1] = (value == BT_GATT_CCC_NOTIFY);
	if (scheduled_params.con_interval != 0) {
		bt_its_send_ble_params_info(&scheduled_params);
		scheduled_params.con_interval = 0;
	}
	if (its_cb.ready_cb) {
		its_cb.ready_cb();
	}
}

static ssize_t its_rx_received(struct bt_conn *conn,
			 const struct bt_gatt_attr *attr,
			 const void *buf,
			 uint16_t len, uint16_t offset, uint8_t flags)
{
	LOG_DBG("Attribute write, handle: %u, conn: %p", attr->handle,
		(void *)conn);

	if (offset != 0) {
		LOG_DBG("Write RX char: Incorrect data offset");
		return BT_GATT_ERR(BT_ATT_ERR_INVALID_OFFSET);
	}

	uint8_t *byte_ptr = (uint8_t*)buf;

	if (its_cb.rx_cb) {
		cb_evt.command = byte_ptr[0];
		cb_evt.data = &byte_ptr[1];
		cb_evt.len = len - 1;
		its_cb.rx_cb(&cb_evt);
	}

	return len;
}

#ifdef CONFIG_BT_ITS_POLL_BUTTON
static ssize_t read_button(struct bt_conn *conn,
			  const struct bt_gatt_attr *attr,
			  void *buf,
			  uint16_t len,
			  uint16_t offset)
{
	const char *value = attr->user_data;

	LOG_DBG("Attribute read, handle: %u, conn: %p", attr->handle,
		(void *)conn);

	if (its_cb.button_cb) {
		button_state = its_cb.button_cb();
		return bt_gatt_attr_read(conn, attr, buf, len, offset, value,
					 sizeof(*value));
	}

	return 0;
}
#endif

/* LED Button Service Declaration */
BT_GATT_SERVICE_DEFINE(its_svc,
BT_GATT_PRIMARY_SERVICE(BT_UUID_ITS), 					    // Attr index: 0
	BT_GATT_CHARACTERISTIC(BT_UUID_ITS_TX,					// Attr index: 1,2
			       BT_GATT_CHRC_READ | BT_GATT_CHRC_NOTIFY,
			       BT_GATT_PERM_READ, NULL, NULL, NULL),
	BT_GATT_CCC(its_tx_ccc_changed,							// Attr index: 3
		    BT_GATT_PERM_READ | BT_GATT_PERM_WRITE),
	BT_GATT_CHARACTERISTIC(BT_UUID_ITS_RX,					// Attr index: 4,5
			       BT_GATT_CHRC_WRITE,
			       BT_GATT_PERM_WRITE,
			       NULL, its_rx_received, NULL),
	BT_GATT_CHARACTERISTIC(BT_UUID_ITS_IMG_INFO,			// Attr index: 6,7
			       BT_GATT_CHRC_READ | BT_GATT_CHRC_NOTIFY,
			       BT_GATT_PERM_READ, NULL, NULL, NULL),
	BT_GATT_CCC(its_img_info_ccc_changed,				    // Attr index: 8
		    BT_GATT_PERM_READ | BT_GATT_PERM_WRITE),
);

int bt_its_init(struct bt_its_cb *callbacks)
{
	if (callbacks) {
		its_cb.ready_cb = callbacks->ready_cb;
		its_cb.rx_cb = callbacks->rx_cb;
	}

	return 0;
}

int bt_its_send_img_data(struct bt_conn *conn, const uint8_t *buf, uint16_t length, uint16_t le_max_length)
{
	int err;
	const uint8_t *current_buf = buf;

	LOG_DBG("IMG buf length %i", length);
	while (length > le_max_length) {
		LOG_DBG("Notify TX: Len %i, Remaining: %i", le_max_length, length);
		err = bt_gatt_notify(NULL, &its_svc.attrs[2], current_buf, le_max_length);
		if (err < 0) {
			LOG_ERR("BT notify error: %i", err);
		}
		current_buf += le_max_length;
		length -= le_max_length;
	}

	LOG_DBG("Notify TX remaining %i bytes", length);
	err = bt_gatt_notify(NULL, &its_svc.attrs[2], current_buf, length);
	if (err < 0) {
		LOG_ERR("BT notify error: %i", err);
	}

	return 0;
}

int bt_its_send_img_info(struct its_img_info_t * img_info)
{
	uint8_t notify_buf[1 + sizeof(struct its_img_info_t)];

	if (!notify_enabled[1]) {
		return -EACCES;
	}

	notify_buf[0] = ITS_IMG_INFO_DATA_TYPE_IMG_INFO;
	memcpy(&notify_buf[1], img_info, sizeof(struct its_img_info_t));
	
	LOG_DBG("IMG info Notify TX %i bytes. Img size: %i", 1 + sizeof(struct its_img_info_t), img_info->file_size_bytes);
	
	return bt_gatt_notify(NULL, &its_svc.attrs[7], 
						  notify_buf, 1 + sizeof(struct its_img_info_t));
}

int bt_its_send_client_status(struct its_client_status_t * client_status)
{
	uint8_t data_size = sizeof(struct its_client_status_t);
	uint8_t notify_buf[data_size + 1];

	if (!notify_enabled[1]) {
		return -EACCES;
	}

	notify_buf[0] = ITS_IMG_INFO_DATA_TYPE_CLIENT_STATUS;
	memcpy(&notify_buf[1], client_status, data_size);
	
	LOG_DBG("Client status Notify TX %i bytes. Cam model %i, resolution: %i", data_size + 1, 
			client_status->camera_type, client_status->selected_resolution_index);

	return bt_gatt_notify(NULL, &its_svc.attrs[7], notify_buf, data_size + 1);
}

int bt_its_send_ble_params_info(struct its_ble_params_info_t* ble_params_info)
{
	uint8_t notify_buf[1 + sizeof(struct its_ble_params_info_t)];

	if (!notify_enabled[1]) {
		// If notifications have not yet been enabled, schedule the params to be sent later
		scheduled_params = *ble_params_info;
		LOG_DBG("Scheduling params info for later");
		
		return 0;
	}

	notify_buf[0] = ITS_IMG_INFO_DATA_TYPE_BLE_PARAMS;
	memcpy(&notify_buf[1], ble_params_info, sizeof(struct its_ble_params_info_t));
	
	LOG_DBG("BLE params Notify TX %i bytes",  1 + sizeof(struct its_ble_params_info_t));
	
	return bt_gatt_notify(NULL, &its_svc.attrs[7], 
						  notify_buf, 1 + sizeof(struct its_ble_params_info_t));
}
```

## src/socket_util.c
```c
/*
 * Copyright (c) 2024 Nordic Semiconductor ASA
 *
 * SPDX-License-Identifier: LicenseRef-Nordic-5-Clause
 */
#include <zephyr/logging/log.h>
LOG_MODULE_REGISTER(socket_util, CONFIG_LOG_DEFAULT_LEVEL);

#include <errno.h>
#include <stddef.h>
#include <string.h>
#include <stdio.h>
#include <zephyr/kernel.h>
#include <zephyr/types.h>
#include <zephyr/net/socket.h>
/* Macro called upon a fatal error, reboots the device. */
#include <zephyr/sys/reboot.h>
#include <dk_buttons_and_leds.h>
#include <zephyr/logging/log_ctrl.h>
#include "socket_util.h"

#define FATAL_ERROR()                              \
	LOG_ERR("Fatal error! Rebooting the device."); \
	LOG_PANIC();                                   \
	IF_ENABLED(CONFIG_REBOOT, (sys_reboot(0)))

/* size of stack area used by each thread */
#define STACKSIZE 8192
/* scheduling priority used by each thread */
#define PRIORITY 3
/* Same as COMMAND_MAX_SIZE*/
#define BUFFER_MAX_SIZE 6

//#define pc_port  60000
#define cam_port 60010 // use for either udp or tcp server


/**********External Resources START**************/
extern int wifi_softap_mode_ready(void);
extern int wifi_station_mode_ready(void);
/**********External Resources END**************/

int udp_socket;
int tcp_server_listen_fd;
int tcp_server_socket;
struct sockaddr_in cam_addr;
bool socket_connected=false;

char pc_addr_str[32];
struct sockaddr_in pc_addr;
socklen_t pc_addr_len=sizeof(pc_addr);

/* Define the semaphore wifi_net_ready */
struct k_sem wifi_net_ready;
enum wifi_modes wifi_mode= WIFI_STATION_MODE;

uint8_t socket_recv_buf[BUFFER_MAX_SIZE];
K_MSGQ_DEFINE(socket_recv_queue, sizeof(socket_recv_buf), 1, 4);

static net_util_socket_rx_callback_t socket_rx_cb = 0; 

void net_util_set_callback(net_util_socket_rx_callback_t socket_rx_callback)
{
	socket_rx_cb = socket_rx_callback;
	// If any messages are waiting in the queue, forward them immediately
	uint8_t buf[6];
	while (k_msgq_get(&socket_recv_queue, buf, K_NO_WAIT) == 0) {
		socket_rx_cb(buf, 6);
		LOG_HEXDUMP_INF(buf, 6, "socket_rx_cb");
	}
}

uint8_t process_socket_rx_buffer(char *socket_rx_buf, char *command_buf)
{
	uint8_t command_length = 0;

	// Check if socket_rx_buf contains start code (0x55)
	if (socket_rx_buf[0] == 0x55)
	{
		// Find the end code (0xAA) and extract the command
		for (uint8_t i = 1; i < CAM_COMMAND_MAX_SIZE; i++)
		{
			if (socket_rx_buf[i] == 0xAA)
			{
				// Copy the command to command_buf
				for (uint8_t j = 1; j < i; j++)
				{
					command_buf[j - 1] = socket_rx_buf[j];
				}
				command_length = i - 1; // Length of the command
				break;
			}
		}
	}
	return command_length;
}

static void trigger_socket_rx_callback_if_set()
{
	if (socket_rx_cb != 0) {
		socket_rx_cb(socket_recv_buf, 6);
	} else {
		k_msgq_put(&socket_recv_queue, &socket_recv_buf, K_NO_WAIT);
	}
}

static void button_handler(uint32_t button_state, uint32_t has_changed)
{
	uint32_t buttons = button_state & has_changed;
	if (buttons & DK_BTN1_MSK) {
		wifi_mode = WIFI_SOFTAP_MODE;
	}else if (buttons & DK_BTN2_MSK){
		close(tcp_server_listen_fd);
		close(tcp_server_socket);
	}
}

// void cam_send(const void *buf, size_t len){
// 		#if defined(CONFIG_SAMPLE_SCOKET_TCP)
// 			if (send(tcp_server_socket, buf, len, 0) == -1) {
// 				perror("Sending failed");
// 				close(tcp_server_socket);
// 				FATAL_ERROR();
// 				return;
// 			}
// 		#else
// 			sendto(udp_socket, buf, len, 0, (struct sockaddr *)&pc_addr,  sizeof(pc_addr));
// 		#endif
// }
void cam_send(const void *buf, size_t len){
    #if defined(CONFIG_SAMPLE_SCOKET_TCP)
        size_t total_sent = 0;
        int retry_count = 0;
        const int MAX_RETRIES = 3;
        
        while (total_sent < len && retry_count < MAX_RETRIES) {
            ssize_t sent = send(tcp_server_socket,
                               (uint8_t*)buf + total_sent,
                               len - total_sent, 0);
            if (sent == -1) {
                if (errno == EAGAIN || errno == EWOULDBLOCK) {
                    // 缓冲区满，稍后重试
                    k_sleep(K_MSEC(10));
                    retry_count++;
                    continue;
                }
                // 其他错误，连接断开
                perror("Sending failed");
                close(tcp_server_socket);
                return;
            }
            total_sent += sent;
            retry_count = 0; // 成功发送后重置重试计数
        }
        
        if (total_sent < len) {
            LOG_ERR("Failed to send all data after retries");
        }
    #else
        sendto(udp_socket, buf, len, 0, (struct sockaddr *)&pc_addr, sizeof(pc_addr));
    #endif
}

/* Thread to setup WiFi, Network, Sockets step by step */
static void wifi_net_sockets(void)
{
	int ret;
	ssize_t bytes_recived;

	k_sem_init(&wifi_net_ready, 0, 1);

	if (dk_leds_init() != 0)
	{
		LOG_ERR("Failed to initialize the LED library");
	}
	if (dk_buttons_init(button_handler)!= 0)
	{
		LOG_ERR("Failed to initialize the LED library");
	}
	LOG_INF("\r\n\r\nPress Button1 in THREE seconds to change WiFi from Station mode to softAP mode.\r\n");
	k_sleep(K_SECONDS(1));

    if(wifi_mode == WIFI_SOFTAP_MODE){
		ret = wifi_softap_mode_ready();
	}else{
		ret = wifi_station_mode_ready();
	}

	if (ret < 0)
	{
		LOG_ERR("wifi network connection is not ready, error: %d", -errno);
		FATAL_ERROR();
		return;
	}

	cam_addr.sin_family = AF_INET;
	cam_addr.sin_addr.s_addr = htonl(INADDR_ANY);
	cam_addr.sin_port = htons(cam_port);

	#if defined(CONFIG_SAMPLE_SCOKET_TCP)
		tcp_server_listen_fd = socket(AF_INET, SOCK_STREAM, IPPROTO_TCP);
		
		if (tcp_server_listen_fd < 0)
		{
			LOG_ERR("Failed to create socket: %d", -errno);
			FATAL_ERROR();
			return;
		}
		
		ret = bind(tcp_server_listen_fd, (struct sockaddr *)&cam_addr, sizeof(cam_addr));
		if (ret < 0)
		{
			LOG_ERR("bind, error: %d", -errno);
			FATAL_ERROR();
			return;
		}

		ret = listen(tcp_server_listen_fd, 5);
		if (ret < 0)
		{
			LOG_ERR("listen, error: %d", -errno);
			FATAL_ERROR();
			return;
		}

		while(1){
			tcp_server_socket = accept(tcp_server_listen_fd, (struct sockaddr *)&pc_addr, &pc_addr_len);
			if (tcp_server_socket < 0)
			{
				LOG_ERR("accept, error: %d", -errno);
				FATAL_ERROR();
				return;
			}
			LOG_INF("Accepted connection from client\n");
			inet_ntop(pc_addr.sin_family, &pc_addr.sin_addr, pc_addr_str, sizeof(pc_addr_str));
			LOG_INF("Connect with PC through WiFi, PC IPAddr = %s, Port = %d\n", pc_addr_str, ntohs(pc_addr.sin_port));
			// Handle the client connection
			while((bytes_recived = recv(tcp_server_socket, socket_recv_buf, sizeof(socket_recv_buf),0))>0){
				trigger_socket_rx_callback_if_set(socket_recv_buf);
			}
			if (bytes_recived == -1) {
				LOG_ERR("Receiving failed");
			} else if (bytes_recived == 0) {
				LOG_INF("Client disconnected.\n");
			}
			close(tcp_server_socket);
		}
		// Close the server socket (should be unreachable  as the server runs indefinitely)
		close(tcp_server_listen_fd);
	#else
		udp_socket = socket(AF_INET, SOCK_DGRAM, IPPROTO_UDP);
		if (udp_socket < 0)
		{
			LOG_ERR("Failed to create socket: %d", -errno);
			FATAL_ERROR();
			return;
		}
		ret = bind(udp_socket, (struct sockaddr *)&cam_addr, sizeof(cam_addr));
		if (ret < 0)
		{
			LOG_ERR("bind, error: %d", -errno);
			FATAL_ERROR();
			return;
		}
		while((bytes_recived = recvfrom(udp_socket, socket_recv_buf, sizeof(socket_recv_buf), 0, (struct sockaddr *)&pc_addr, &pc_addr_len))>0){
			if(socket_connected == false){
				inet_ntop(pc_addr.sin_family, &pc_addr.sin_addr, pc_addr_str, sizeof(pc_addr_str));
				LOG_INF("Connect with PC through WiFi, PC IPAddr = %s, Port = %d\n", pc_addr_str, ntohs(pc_addr.sin_port));
				socket_connected=true;
			}
			trigger_socket_rx_callback_if_set(socket_recv_buf);
		}
		if (bytes_recived == -1) {
			LOG_ERR("Receiving failed");
		} else if (bytes_recived == 0) {
			LOG_INF("Client disconnected.\n");
		}

		close(udp_socket);
		socket_connected=false;

	#endif
}

K_THREAD_DEFINE(wifi_net_sockets_id, STACKSIZE, wifi_net_sockets, NULL, NULL, NULL,
				PRIORITY, 0, 0);
```
